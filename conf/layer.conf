## conf/layer.conf
```bitbake
# We have a conf and classes directory, add to BBPATH
BBPATH .= ":${LAYERDIR}"

# We have recipes-* directories, add to BBFILES
BBFILES += "${LAYERDIR}/recipes-*/*/*.bb \
            ${LAYERDIR}/recipes-*/*/*.bbappend"

BBFILE_COLLECTIONS += "elbb"
BBFILE_PATTERN_elbb = "^${LAYERDIR}/"
BBFILE_PRIORITY_elbb = "10"

LAYERSERIES_COMPAT_elbb = "dunfell"

# partition layout
WKS_FILE = "elbb.wks.in"

# rootfs config
EXTRA_IMAGE_FEATURES_append = " read-only-rootfs"
IMAGE_FSTYPES ??= "ext4.gz wic.bz2 wic.bmap"

# install kernel to rootfs and remove it from boot partition
CORE_IMAGE_EXTRA_INSTALL += "kernel-image"
IMAGE_BOOT_FILES_remove = "Image"

# limit max rootfs size
IMAGE_ROOTFS_MAXSIZE = "524288"
# overhead doesnt make much sense in a read-only-roots
# we minimize the overhead factor (needed for fs) so we don't reach maxsize
IMAGE_OVERHEAD_FACTOR = "1.05"

# configure persistent journal
###
# We prefix the upstream journald config parameters with "JOURNALD_".
# https://www.freedesktop.org/software/systemd/man/journald.conf.html#SystemMaxUse=
JOURNALD_SystemMaxUse ??= "64M"
#JOURNALD_SystemKeepFree
#JOURNALD_SystemMaxFileSize
#JOURNALD_SystemMaxFiles
#JOURNALD_RuntimeMaxUse
#JOURNALD_RuntimeKeepFree
#JOURNALD_RuntimeMaxFileSize
#JOURNALD_RuntimeMaxFiles
VOLATILE_LOG_DIR ?= "${@bb.utils.contains('DISTRO_FEATURES', 'persistent-journal', 'no', 'yes', d)}"
```

## meta-elbb-raspberrypi/conf/layer.conf
```bitbake
# We have a conf and classes directory, add to BBPATH
BBPATH .= ":${LAYERDIR}"

# We have recipes-* directories, add to BBFILES
BBFILES += "${LAYERDIR}/recipes-*/*/*.bb \
            ${LAYERDIR}/recipes-*/*/*.bbappend"

BBFILE_COLLECTIONS += "elbb-raspberrypi"
BBFILE_PATTERN_elbb-raspberrypi = "^${LAYERDIR}/"
BBFILE_PRIORITY_elbb-raspberrypi = "10"

LAYERDEPENDS_elbb-raspberrypi = "elbb raspberrypi swupdate"
LAYERSERIES_COMPAT_elbb-raspberrypi = "dunfell"

# uboot to be able to switch A/B
RPI_USE_U_BOOT = "1"
PREFERRED_PROVIDER_u-boot-fw-utils = "libubootenv"
CORE_IMAGE_EXTRA_INSTALL += "u-boot-fw-utils"

# Add tpm support if DISTRO_FEATURES include 'tpm'.
# Since we don't know the DISTRO_FEATURES during layer.conf load time, we
# delay using a special bbclass that simply includes the TPM_CONFIG_PATH file.
TPM_CONFIG_PATH = "${LAYERDIR}/conf/tpm-cfg.conf"
USER_CLASSES_append = " ${@bb.utils.contains('DISTRO_FEATURES', 'tpm', 'tpm-cfg', '', d)}"
```
